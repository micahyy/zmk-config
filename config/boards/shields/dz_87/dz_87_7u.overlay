// Build-time extra overlay for ANSI 7u space (86 keys) ONLY.
// Passing -DDTC_OVERLAY_FILE drops the auto-added dz_87.keymap, so include it.
#include "dz_87.keymap"

// This firmware exposes only the 7u layout; remove the others from the list.
&dz87_625 { status = "disabled"; };
&dz87_all { status = "disabled"; };
