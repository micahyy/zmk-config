## config/Kconfig
```kconfig
config CZMAO_DZ17_INDICATORS
    bool "CZMAO DZ17 BLE/USB LED indicators"
    default y if SHIELD_DZ17

config CZMAO_DZ_87_INDICATORS
    bool "CZMAO DZ 87 BLE/USB + Caps/Scroll LED indicators"
    default y if SHIELD_DZ_87
```

## config/dts/bindings/czmao,dz17-indicators.yaml
```yaml
description: |
  DZ17 multi-position LED strip indicator proxy.
  Sits between ZMK underglow and the real WS2812 strip, overlaying
  BLE/USB connection status colors on specific key LEDs while
  leaving the rest of the strip running normal animations.

compatible: "czmao,dz17-indicators"

include: base.yaml

properties:
  target:
    type: phandle
    required: true
    description: The real LED strip device to forward frames to.

  chain-length:
    type: int
    required: true
    description: Total number of pixels on the strip.

  indicator-indices:
    type: array
    required: true
    description: |
      LED indices for indicators, in order:
      [ble0_index, ble1_index, ble2_index, usb_index]

  indicator-colors:
    type: array
    required: true
    description: |
      Colors (0xRRGGBB) for indicators, in same order as indices.
```

## config/west.yml
```yaml
manifest:
  remotes:
    - name: micahyy
      url-base: https://github.com/micahyy
  projects:
    - name: zmk
      remote: micahyy
      revision: d02621f8df5194cf81e39132bd195e8bf73f32e8
      import: app/west.yml
  self:
    path: config
```

## west.yml
```yaml
manifest:
  remotes:
    - name: micahyy
      url-base: https://github.com/micahyy
  projects:
    - name: zmk
      remote: micahyy
      revision: d55c55a9a9a60c0e274088ffb3017195a885e625
      import: app/west.yml
  self:
    path: config
```
